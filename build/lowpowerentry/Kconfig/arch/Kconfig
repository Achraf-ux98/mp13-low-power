## build/lowpowerentry/Kconfig/arch/Kconfig
```kconfig
# Load Zephyr Arch Kconfig descriptions.
osource "/local/home/achraftm/zephyrproject/zephyr/arch/rx/Kconfig"
osource "/local/home/achraftm/zephyrproject/zephyr/arch/x86/Kconfig"
osource "/local/home/achraftm/zephyrproject/zephyr/arch/xtensa/Kconfig"
osource "/local/home/achraftm/zephyrproject/zephyr/arch/sparc/Kconfig"
osource "/local/home/achraftm/zephyrproject/zephyr/arch/riscv/Kconfig"
osource "/local/home/achraftm/zephyrproject/zephyr/arch/posix/Kconfig"
osource "/local/home/achraftm/zephyrproject/zephyr/arch/openrisc/Kconfig"
osource "/local/home/achraftm/zephyrproject/zephyr/arch/mips/Kconfig"
osource "/local/home/achraftm/zephyrproject/zephyr/arch/arm64/Kconfig"
osource "/local/home/achraftm/zephyrproject/zephyr/arch/arm/Kconfig"
osource "/local/home/achraftm/zephyrproject/zephyr/arch/arc/Kconfig"
```

## build/lowpowerentry/Kconfig/boards/Kconfig.defconfig
```kconfig
# Load Zephyr board defconfig descriptions.
osource "/local/home/achraftm/zephyrproject/zephyr/boards/st/stm32mp135f_dk/Kconfig.defconfig"
```

## build/lowpowerentry/Kconfig/boards/Kconfig.stm32mp135f_dk
```kconfig
# Load board Kconfig descriptions.
osource "/local/home/achraftm/zephyrproject/zephyr/boards/st/stm32mp135f_dk/Kconfig.stm32mp135f_dk"
```

## build/lowpowerentry/Kconfig/boards/Kconfig.sysbuild
```kconfig
# Load Sysbuild board Kconfig descriptions.
osource "/local/home/achraftm/zephyrproject/zephyr/boards/st/stm32mp135f_dk/Kconfig.sysbuild"
```

## build/lowpowerentry/Kconfig/soc/Kconfig
```kconfig
# Load Zephyr SoC Kconfig descriptions.
osource "/local/home/achraftm/zephyrproject/zephyr/soc/xlnx/zynqmp/Kconfig"
osource "/local/home/achraftm/zephyrproject/zephyr/soc/xlnx/zynq7000/Kconfig"
osource "/local/home/achraftm/zephyrproject/zephyr/soc/xlnx/versalnet/Kconfig"
osource "/local/home/achraftm/zephyrproject/zephyr/soc/xlnx/versal2/Kconfig"
osource "/local/home/achraftm/zephyrproject/zephyr/soc/xlnx/versal/Kconfig"
osource "/local/home/achraftm/zephyrproject/zephyr/soc/xen/Kconfig"
osource "/local/home/achraftm/zephyrproject/zephyr/soc/wch/ch32v/Kconfig"
osource "/local/home/achraftm/zephyrproject/zephyr/soc/ti/simplelink/Kconfig"
osource "/local/home/achraftm/zephyrproject/zephyr/soc/ti/mspm0/Kconfig"
osource "/local/home/achraftm/zephyrproject/zephyr/soc/ti/lm3s6965/Kconfig"
osource "/local/home/achraftm/zephyrproject/zephyr/soc/ti/k3/Kconfig"
osource "/local/home/achraftm/zephyrproject/zephyr/soc/telink/tlsr/Kconfig"
osource "/local/home/achraftm/zephyrproject/zephyr/soc/syna/sr100/Kconfig"
osource "/local/home/achraftm/zephyrproject/zephyr/soc/starfive/jh71xx/Kconfig"
osource "/local/home/achraftm/zephyrproject/zephyr/soc/st/stm32/Kconfig"
osource "/local/home/achraftm/zephyrproject/zephyr/soc/snps/qemu_arc/Kconfig"
osource "/local/home/achraftm/zephyrproject/zephyr/soc/snps/nsim/arc_v/Kconfig"
osource "/local/home/achraftm/zephyrproject/zephyr/soc/snps/nsim/arc_classic/Kconfig"
osource "/local/home/achraftm/zephyrproject/zephyr/soc/snps/hsdk4xd/Kconfig"
osource "/local/home/achraftm/zephyrproject/zephyr/soc/snps/hsdk/Kconfig"
osource "/local/home/achraftm/zephyrproject/zephyr/soc/snps/emsk/Kconfig"
osource "/local/home/achraftm/zephyrproject/zephyr/soc/snps/emsdp/Kconfig"
osource "/local/home/achraftm/zephyrproject/zephyr/soc/snps/arc_iot/Kconfig"
osource "/local/home/achraftm/zephyrproject/zephyr/soc/silabs/Kconfig"
osource "/local/home/achraftm/zephyrproject/zephyr/soc/sifli/sf32/Kconfig"
osource "/local/home/achraftm/zephyrproject/zephyr/soc/sifive/sifive_freedom/Kconfig"
osource "/local/home/achraftm/zephyrproject/zephyr/soc/sensry/Kconfig"
osource "/local/home/achraftm/zephyrproject/zephyr/soc/rockchip/Kconfig"
osource "/local/home/achraftm/zephyrproject/zephyr/soc/renode/riscv_virtual/Kconfig"
osource "/local/home/achraftm/zephyrproject/zephyr/soc/renode/cortex_r8_virtual/Kconfig"
osource "/local/home/achraftm/zephyrproject/zephyr/soc/renesas/smartbond/Kconfig"
osource "/local/home/achraftm/zephyrproject/zephyr/soc/renesas/rz/Kconfig"
osource "/local/home/achraftm/zephyrproject/zephyr/soc/renesas/rx/Kconfig"
osource "/local/home/achraftm/zephyrproject/zephyr/soc/renesas/rcar/Kconfig"
osource "/local/home/achraftm/zephyrproject/zephyr/soc/renesas/ra/Kconfig"
osource "/local/home/achraftm/zephyrproject/zephyr/soc/realtek/fingerprint/Kconfig"
osource "/local/home/achraftm/zephyrproject/zephyr/soc/realtek/ec/Kconfig"
osource "/local/home/achraftm/zephyrproject/zephyr/soc/realtek/bee/Kconfig"
osource "/local/home/achraftm/zephyrproject/zephyr/soc/realtek/ameba/Kconfig"
osource "/local/home/achraftm/zephyrproject/zephyr/soc/raspberrypi/rpi_pico/Kconfig"
osource "/local/home/achraftm/zephyrproject/zephyr/soc/quicklogic/eos_s3/Kconfig"
osource "/local/home/achraftm/zephyrproject/zephyr/soc/qemu/virt_riscv/Kconfig"
osource "/local/home/achraftm/zephyrproject/zephyr/soc/qemu/or1k/Kconfig"
osource "/local/home/achraftm/zephyrproject/zephyr/soc/qemu/malta/Kconfig"
osource "/local/home/achraftm/zephyrproject/zephyr/soc/openisa/rv32m1/Kconfig"
osource "/local/home/achraftm/zephyrproject/zephyr/soc/openhwgroup/cva6/Kconfig"
osource "/local/home/achraftm/zephyrproject/zephyr/soc/oct/osd32mp15x/Kconfig"
osource "/local/home/achraftm/zephyrproject/zephyr/soc/nxp/s32/Kconfig"
osource "/local/home/achraftm/zephyrproject/zephyr/soc/nxp/rw/Kconfig"
osource "/local/home/achraftm/zephyrproject/zephyr/soc/nxp/mcx/Kconfig"
osource "/local/home/achraftm/zephyrproject/zephyr/soc/nxp/lpc/Kconfig"
osource "/local/home/achraftm/zephyrproject/zephyr/soc/nxp/layerscape/Kconfig"
osource "/local/home/achraftm/zephyrproject/zephyr/soc/nxp/kinetis/Kconfig"
osource "/local/home/achraftm/zephyrproject/zephyr/soc/nxp/imxrt/Kconfig"
osource "/local/home/achraftm/zephyrproject/zephyr/soc/nxp/imx/Kconfig"
osource "/local/home/achraftm/zephyrproject/zephyr/soc/nuvoton/numicro/Kconfig"
osource "/local/home/achraftm/zephyrproject/zephyr/soc/nuvoton/numaker/Kconfig"
osource "/local/home/achraftm/zephyrproject/zephyr/soc/nuvoton/npcx/Kconfig"
osource "/local/home/achraftm/zephyrproject/zephyr/soc/nuvoton/npcm/Kconfig"
osource "/local/home/achraftm/zephyrproject/zephyr/soc/nordic/Kconfig"
osource "/local/home/achraftm/zephyrproject/zephyr/soc/neorv32/Kconfig"
osource "/local/home/achraftm/zephyrproject/zephyr/soc/native/inf_clock/Kconfig"
osource "/local/home/achraftm/zephyrproject/zephyr/soc/microchip/sam/sama7/Kconfig"
osource "/local/home/achraftm/zephyrproject/zephyr/soc/microchip/sam/sam_d5x_e5x/Kconfig"
osource "/local/home/achraftm/zephyrproject/zephyr/soc/microchip/pic64/Kconfig"
osource "/local/home/achraftm/zephyrproject/zephyr/soc/microchip/pic32c/pic32cz_ca/Kconfig"
osource "/local/home/achraftm/zephyrproject/zephyr/soc/microchip/pic32c/pic32cx_sg/Kconfig"
osource "/local/home/achraftm/zephyrproject/zephyr/soc/microchip/pic32c/pic32cm_sg_gc/Kconfig"
osource "/local/home/achraftm/zephyrproject/zephyr/soc/microchip/pic32c/pic32cm_pl/Kconfig"
osource "/local/home/achraftm/zephyrproject/zephyr/soc/microchip/pic32c/pic32cm_jh/Kconfig"
osource "/local/home/achraftm/zephyrproject/zephyr/soc/microchip/pic32c/pic32ck_sg_gc/Kconfig"
osource "/local/home/achraftm/zephyrproject/zephyr/soc/microchip/miv/Kconfig"
osource "/local/home/achraftm/zephyrproject/zephyr/soc/microchip/mec/Kconfig"
osource "/local/home/achraftm/zephyrproject/zephyr/soc/mediatek/mt8xxx/Kconfig"
osource "/local/home/achraftm/zephyrproject/zephyr/soc/lowrisc/opentitan/Kconfig"
osource "/local/home/achraftm/zephyrproject/zephyr/soc/litex/Kconfig"
osource "/local/home/achraftm/zephyrproject/zephyr/soc/ite/ec/Kconfig"
osource "/local/home/achraftm/zephyrproject/zephyr/soc/intel/wildcat_lake/Kconfig"
osource "/local/home/achraftm/zephyrproject/zephyr/soc/intel/raptor_lake/Kconfig"
osource "/local/home/achraftm/zephyrproject/zephyr/soc/intel/panther_lake/Kconfig"
osource "/local/home/achraftm/zephyrproject/zephyr/soc/intel/lakemont/Kconfig"
osource "/local/home/achraftm/zephyrproject/zephyr/soc/intel/intel_socfpga_std/Kconfig"
osource "/local/home/achraftm/zephyrproject/zephyr/soc/intel/intel_socfpga/Kconfig"
osource "/local/home/achraftm/zephyrproject/zephyr/soc/intel/intel_niosv/Kconfig"
osource "/local/home/achraftm/zephyrproject/zephyr/soc/intel/intel_ish/Kconfig"
osource "/local/home/achraftm/zephyrproject/zephyr/soc/intel/intel_adsp/Kconfig"
osource "/local/home/achraftm/zephyrproject/zephyr/soc/intel/elkhart_lake/Kconfig"
osource "/local/home/achraftm/zephyrproject/zephyr/soc/intel/atom/Kconfig"
osource "/local/home/achraftm/zephyrproject/zephyr/soc/intel/apollo_lake/Kconfig"
osource "/local/home/achraftm/zephyrproject/zephyr/soc/intel/alder_lake/Kconfig"
osource "/local/home/achraftm/zephyrproject/zephyr/soc/infineon/psoc4/Kconfig"
osource "/local/home/achraftm/zephyrproject/zephyr/soc/infineon/edge/Kconfig"
osource "/local/home/achraftm/zephyrproject/zephyr/soc/infineon/cat3/Kconfig"
osource "/local/home/achraftm/zephyrproject/zephyr/soc/infineon/cat1c/Kconfig"
osource "/local/home/achraftm/zephyrproject/zephyr/soc/infineon/cat1b/Kconfig"
osource "/local/home/achraftm/zephyrproject/zephyr/soc/infineon/cat1a/Kconfig"
osource "/local/home/achraftm/zephyrproject/zephyr/soc/gd/gd32/Kconfig"
osource "/local/home/achraftm/zephyrproject/zephyr/soc/gaisler/leon3/Kconfig"
osource "/local/home/achraftm/zephyrproject/zephyr/soc/gaisler/gr716a/Kconfig"
osource "/local/home/achraftm/zephyrproject/zephyr/soc/focaltech/Kconfig"
osource "/local/home/achraftm/zephyrproject/zephyr/soc/espressif/Kconfig"
osource "/local/home/achraftm/zephyrproject/zephyr/soc/ene/kb1200/Kconfig"
osource "/local/home/achraftm/zephyrproject/zephyr/soc/ene/kb106x/Kconfig"
osource "/local/home/achraftm/zephyrproject/zephyr/soc/elan/em32f967/Kconfig"
osource "/local/home/achraftm/zephyrproject/zephyr/soc/egis/Kconfig"
osource "/local/home/achraftm/zephyrproject/zephyr/soc/efinix/sapphire/Kconfig"
osource "/local/home/achraftm/zephyrproject/zephyr/soc/cdns/xtensa_sample_controller/Kconfig"
osource "/local/home/achraftm/zephyrproject/zephyr/soc/cdns/swerv/Kconfig"
osource "/local/home/achraftm/zephyrproject/zephyr/soc/cdns/sample_controller32/Kconfig"
osource "/local/home/achraftm/zephyrproject/zephyr/soc/cdns/dc233c/Kconfig"
osource "/local/home/achraftm/zephyrproject/zephyr/soc/brcm/bcmvk/Kconfig"
osource "/local/home/achraftm/zephyrproject/zephyr/soc/brcm/bcm2712/Kconfig"
osource "/local/home/achraftm/zephyrproject/zephyr/soc/brcm/bcm2711/Kconfig"
osource "/local/home/achraftm/zephyrproject/zephyr/soc/blackberry/qnxhv_vm/Kconfig"
osource "/local/home/achraftm/zephyrproject/zephyr/soc/bflb/Kconfig"
osource "/local/home/achraftm/zephyrproject/zephyr/soc/atmel/sam0/Kconfig"
osource "/local/home/achraftm/zephyrproject/zephyr/soc/atmel/sam/Kconfig"
osource "/local/home/achraftm/zephyrproject/zephyr/soc/aspeed/Kconfig"
osource "/local/home/achraftm/zephyrproject/zephyr/soc/arm/Kconfig"
osource "/local/home/achraftm/zephyrproject/zephyr/soc/arm/beetle/Kconfig"
osource "/local/home/achraftm/zephyrproject/zephyr/soc/antmicro/myra/Kconfig"
osource "/local/home/achraftm/zephyrproject/zephyr/soc/andestech/Kconfig"
osource "/local/home/achraftm/zephyrproject/zephyr/soc/amd/acp_7_x/Kconfig"
osource "/local/home/achraftm/zephyrproject/zephyr/soc/amd/acp_7_0/Kconfig"
osource "/local/home/achraftm/zephyrproject/zephyr/soc/amd/acp_6_0/Kconfig"
osource "/local/home/achraftm/zephyrproject/zephyr/soc/ambiq/Kconfig"
osource "/local/home/achraftm/zephyrproject/zephyr/soc/allwinner/sun8i_h3/Kconfig"
osource "/local/home/achraftm/zephyrproject/zephyr/soc/allwinner/sun50i_h618/Kconfig"
osource "/local/home/achraftm/zephyrproject/zephyr/soc/alif/ensemble/Kconfig"
osource "/local/home/achraftm/zephyrproject/zephyr/soc/alif/balletto/Kconfig"
osource "/local/home/achraftm/zephyrproject/zephyr/soc/aesc/Kconfig"
osource "/local/home/achraftm/zephyrproject/zephyr/soc/adi/max32/Kconfig"
```
