## CMakeLists.txt
```
# SPDX-License-Identifier: Apache-2.0

cmake_minimum_required(VERSION 3.20.0)
find_package(Zephyr REQUIRED HINTS $ENV{ZEPHYR_BASE})
project(lplvstop2)

target_sources(app PRIVATE src/main.c)

target_sources(app PRIVATE
	${ZEPHYR_BASE}/../modules/hal/stm32/stm32cube/stm32mp13xx/drivers/src/stm32mp13xx_hal_pwr.c
	${ZEPHYR_BASE}/../modules/hal/stm32/stm32cube/stm32mp13xx/drivers/src/stm32mp13xx_hal_pwr_ex.c
	${ZEPHYR_BASE}/../modules/hal/stm32/stm32cube/stm32mp13xx/drivers/src/stm32mp13xx_hal_gpio.c
	${ZEPHYR_BASE}/../modules/hal/stm32/stm32cube/stm32mp13xx/drivers/src/stm32mp13xx_hal_i2c.c
	${ZEPHYR_BASE}/../modules/hal/stm32/stm32cube/stm32mp13xx/drivers/src/stm32mp13xx_hal_uart.c
	${ZEPHYR_BASE}/../modules/hal/stm32/stm32cube/stm32mp13xx/drivers/src/stm32mp13xx_hal_rtc.c
	${ZEPHYR_BASE}/../modules/hal/stm32/stm32cube/stm32mp13xx/drivers/src/stm32mp13xx_hal_rtc_ex.c
	${ZEPHYR_BASE}/../mp13BareMetal/stm32cubemp13-v1-2-0/STM32Cube_FW_MP13_V1.2.0/Drivers/BSP/STM32MP13xx_DISCO/stm32mp13xx_disco_bus.c
	${ZEPHYR_BASE}/../mp13BareMetal/stm32cubemp13-v1-2-0/STM32Cube_FW_MP13_V1.2.0/Drivers/BSP/STM32MP13xx_DISCO/stm32mp13xx_disco.c
	${ZEPHYR_BASE}/../mp13BareMetal/stm32cubemp13-v1-2-0/STM32Cube_FW_MP13_V1.2.0/Drivers/BSP/STM32MP13xx_DISCO/stm32mp13xx_disco_stpmic1.c
	${ZEPHYR_BASE}/../mp13BareMetal/stm32cubemp13-v1-2-0/STM32Cube_FW_MP13_V1.2.0/Drivers/CMSIS/Core_A/Source/irq_ctrl_gic.c
)

target_include_directories(app PRIVATE
	${ZEPHYR_BASE}/../modules/hal/stm32/stm32cube/stm32mp13xx/soc
	${ZEPHYR_BASE}/../modules/hal/stm32/stm32cube/stm32mp13xx/drivers/include
	${ZEPHYR_BASE}/../modules/hal/stm32/stm32cube/common_ll/include
	${ZEPHYR_BASE}/../mp13BareMetal/stm32cubemp13-v1-2-0/STM32Cube_FW_MP13_V1.2.0/Drivers/BSP/STM32MP13xx_DISCO
	${ZEPHYR_BASE}/../mp13BareMetal/stm32cubemp13-v1-2-0/STM32Cube_FW_MP13_V1.2.0/Drivers/BSP/Components
	${ZEPHYR_BASE}/../mp13BareMetal/stm32cubemp13-v1-2-0/STM32Cube_FW_MP13_V1.2.0/Projects/STM32MP135C-DK/Applications/Low_power_LPLV_Stop2/BSP_BasicTemplates_low_power/Inc
)
```

## prj.conf
```kconfig
CONFIG_PRINTK=y
CONFIG_CONSOLE=y
CONFIG_SERIAL=y
CONFIG_UART_CONSOLE=y
CONFIG_STDOUT_CONSOLE=y
CONFIG_HEAP_MEM_POOL_SIZE=512
CONFIG_MAIN_STACK_SIZE=1024
```

## src/main.c
```c
/* USER CODE BEGIN Header */
/**
	******************************************************************************
	* @file    main.c
	* @author  MCD Application Team
	* @brief   Main program body
	******************************************************************************
	* @attention
	*
	* Copyright (c) 2021 STMicroelectronics.
	* All rights reserved.
	*
	* This software is licensed under terms that can be found in the LICENSE file
	* in the root directory of this software component.
	* If no LICENSE file comes with this software, it is provided AS-IS.
	*
	******************************************************************************
	*/
/* USER CODE END Header */

/* Includes ------------------------------------------------------------------*/
#include "main.h"
#include <zephyr/arch/arm/mmu/arm_mem.h>
#include <zephyr/kernel.h>
#include <zephyr/kernel/mm.h>
#include <zephyr/sys/printk.h>

/* Private includes ----------------------------------------------------------*/
/* USER CODE BEGIN Includes */

/* USER CODE END Includes */

/* Private typedef -----------------------------------------------------------*/
/* USER CODE BEGIN PTD */

/* USER CODE END PTD */

/* Private define ------------------------------------------------------------*/
/* USER CODE BEGIN PD */
#define USE_DDR
#define FSBL_SYSRAM_BASE 0x2FFE0000U
#define FSBL_SYSRAM_SIZE 0x00020000U
/* USER CODE END PD */

/* Private macro -------------------------------------------------------------*/
/* USER CODE BEGIN PM */

/* USER CODE END PM */

/* Private variables ---------------------------------------------------------*/

/* USER CODE BEGIN PV */

__attribute__((section("SYSRAM"), aligned(8)))
static uint8_t fsbl_handoff_stack[1024];

/* USER CODE END PV */

/* Private function prototypes -----------------------------------------------*/
void SystemClock_Config(void);
void PeriphCommonClock_Config(void);
static void MX_GPIO_Init(void);
static void PrepareFsblStackHandoff(void);
extern void arch_mem_map(void *virt, uintptr_t phys, size_t size, uint32_t flags);
RTC_HandleTypeDef RTCHandle_BKUP;
void (*p_FsblEntryPoint)(void); /* Entry point of the FSBL-A low power service */

/* USER CODE BEGIN PFP */

/* USER CODE END PFP */

/* Private user code ---------------------------------------------------------*/
/* USER CODE BEGIN 0 */

/* USER CODE END 0 */

/**
	* @brief  The application entry point.
	* @retval int
	*/
int main(void)
{
	RTC_HandleTypeDef RTCHandle_BKUP;
	uint32_t count = 0;

	/* USER CODE BEGIN 1 */

	/* USER CODE END 1 */

	/* MCU Configuration--------------------------------------------------------*/

	/* USER CODE BEGIN Init */
	/* Configure the system clock */
	printk("step: entering system clock config\n\r");
	SystemClock_Config();
	printk("step: system clock configured\n\r");
  
	HAL_RTC_Init(&RTCHandle_BKUP);
	printk("step: rtc initialized\n\r");
 
#if (USE_STPMIC1x) && !defined(USE_DDR)
	/* Configure PMIC */
	BSP_PMIC_Init();
	printk("step: pmic initialized\n\r");
	printk("step: before pmic regulators init\n\r");
	BSP_PMIC_InitRegulators();
	printk("step: pmic regulators initialized\n\r");
#endif

	/* USER CODE END SysInit */
	/* USER CODE END Init */

	/* USER CODE BEGIN SysInit */
	printk("step: sysinit complete\n\r");

	/* USER CODE END SysInit */

	/* Initialize all configured peripherals */
	MX_GPIO_Init();
	
	printk("step: gpio init skipped\n\r");
  
	printk("Hello World - Landed in user application in DDR\n\r");

	/* USER CODE BEGIN 2 */
	printk("step: user code begin 2\n\r");

	/* USER CODE END 2 */

	/* USER CODE BEGIN 3*/

// add your config test
	printk("step: user code begin 3\n\r");

	/* USER CODE END 3 */

	/* USER CODE BEGIN 4*/
	printk("Hello World - USE_STM32MP13XX_DK BOARD    \n\r");
	printk("step: user code begin 4\n\r");
	/* USER CODE END 4 */

	/* Fill in return address in backup register 0 for FSBL-A to come back */
	HAL_RTCEx_BKUPWrite(&RTCHandle_BKUP, RTC_BKP_DR0,(uint32_t) (&main));
	
	printk("step: backup register written\n\r");
  
	/* Show that the application in DDR is running by toggling red & blue LEDS */
	
	while (count < 10)
	{
		/* USER CODE END WHILE */

		/* USER CODE BEGIN 3 */
		/* Toggle LED_BLUE */
		BSP_LED_Toggle(LED_BLUE);
		HAL_Delay(100);
		BSP_LED_Toggle(LED_RED);
		HAL_Delay(100);
		count++;

	}



	BSP_LED_Off(LED_BLUE);
	BSP_LED_Off(LED_RED);
	printk("step: leds turned off\n\r");

	/* Program a wakeup source - push button of DK */
	HAL_PWR_EnableWakeUpPinIT(PWR_WAKEUP_PIN1);
	HAL_PWR_EnableWakeUpPin(PWR_WAKEUP_PIN1_LOW);
	IRQ_Enable(MPU_WAKEUP_PIN_IRQn);
	printk("step: wakeup source enabled\n\r");
	//PrepareFsblStackHandoff();
  
	/* Print the bootloader-provided backup register 2 value before using it. */
	p_FsblEntryPoint = (void *)(HAL_RTCEx_BKUPRead(&RTCHandle_BKUP, RTC_BKP_DR2));
	printk("step: backup register 2 value = 0x%08x\n\r", (uint32_t)p_FsblEntryPoint);
	printk("step: fsbl entrypoint loaded\n\r");
	arch_mem_map((void *)FSBL_SYSRAM_BASE, FSBL_SYSRAM_BASE, FSBL_SYSRAM_SIZE,
		     K_MEM_ARM_NORMAL_NC | K_MEM_PERM_RW | K_MEM_PERM_EXEC);
	printk("step: fsbl sysram mapped\n\r");
HAL_Delay(1000);
	p_FsblEntryPoint();

	/* This code will never be reached in this application */
	count = 0;
	while (count < 30)
	{
		/* USER CODE END WHILE */

		/* USER CODE BEGIN 3 */
		/* Toggle LED_BLUE */
		BSP_LED_Toggle(LED_BLUE);
		HAL_Delay(30);
		BSP_LED_Toggle(LED_RED);
		count++;
		printk("End of application\n\r");
	}

while(1);
}

/**
	* @brief System Clock Configuration
	* @retval None
	*/

void SystemClock_Config(void)
{
#if !defined(USE_DDR)
	printk("step: sysclock start\n\r");
	HAL_RCC_DeInit();
	printk("step: rcc deinit done\n\r");
	RCC_ClkInitTypeDef RCC_ClkInitStructure;
	RCC_OscInitTypeDef RCC_OscInitStructure;

	/* Enable all available oscillators*/
	RCC_OscInitStructure.OscillatorType = (RCC_OSCILLATORTYPE_HSI |
																				 RCC_OSCILLATORTYPE_HSE | RCC_OSCILLATORTYPE_CSI |
																				 RCC_OSCILLATORTYPE_LSI | RCC_OSCILLATORTYPE_LSE);

	RCC_OscInitStructure.HSIState = RCC_HSI_ON;
	RCC_OscInitStructure.HSEState = RCC_HSE_ON;
	RCC_OscInitStructure.LSEState = RCC_LSE_ON;
	RCC_OscInitStructure.LSIState = RCC_LSI_ON;
	RCC_OscInitStructure.CSIState = RCC_CSI_ON;

	RCC_OscInitStructure.HSICalibrationValue = 0x00; //Default reset value
	RCC_OscInitStructure.CSICalibrationValue = 0x10; //Default reset value
	RCC_OscInitStructure.HSIDivValue = RCC_HSI_DIV1; //Default value

	/* PLL configuration */
	RCC_OscInitStructure.PLL.PLLState = RCC_PLL_ON;
	RCC_OscInitStructure.PLL.PLLSource = RCC_PLL12SOURCE_HSE;
	RCC_OscInitStructure.PLL.PLLM = 3;
	RCC_OscInitStructure.PLL.PLLN = 81;
	RCC_OscInitStructure.PLL.PLLP = 1;
	RCC_OscInitStructure.PLL.PLLQ = 2;
	RCC_OscInitStructure.PLL.PLLR = 2;
	RCC_OscInitStructure.PLL.PLLFRACV = 0x800;
	RCC_OscInitStructure.PLL.PLLMODE = RCC_PLL_FRACTIONAL;

	RCC_OscInitStructure.PLL2.PLLState = RCC_PLL_ON;
	RCC_OscInitStructure.PLL2.PLLSource = RCC_PLL12SOURCE_HSE;
	RCC_OscInitStructure.PLL2.PLLM = 3;
	RCC_OscInitStructure.PLL2.PLLN = 66;
	RCC_OscInitStructure.PLL2.PLLP = 2;
	RCC_OscInitStructure.PLL2.PLLQ = 2;
	RCC_OscInitStructure.PLL2.PLLR = 1;
	RCC_OscInitStructure.PLL2.PLLFRACV = 0x1400;
	RCC_OscInitStructure.PLL2.PLLMODE = RCC_PLL_FRACTIONAL;

	RCC_OscInitStructure.PLL3.PLLState = RCC_PLL_ON;
	RCC_OscInitStructure.PLL3.PLLSource = RCC_PLL3SOURCE_HSE;
	RCC_OscInitStructure.PLL3.PLLM = 2;
	RCC_OscInitStructure.PLL3.PLLN = 34;
	RCC_OscInitStructure.PLL3.PLLP = 2;
	RCC_OscInitStructure.PLL3.PLLQ = 17;
	RCC_OscInitStructure.PLL3.PLLR = 2;
	RCC_OscInitStructure.PLL3.PLLRGE = RCC_PLL3IFRANGE_1;
	RCC_OscInitStructure.PLL3.PLLFRACV = 0x1a04;
	RCC_OscInitStructure.PLL3.PLLMODE = RCC_PLL_FRACTIONAL;

	RCC_OscInitStructure.PLL4.PLLState = RCC_PLL_ON;
	RCC_OscInitStructure.PLL4.PLLSource = RCC_PLL4SOURCE_HSE;
	RCC_OscInitStructure.PLL4.PLLM = 2;
	RCC_OscInitStructure.PLL4.PLLN = 50;
	RCC_OscInitStructure.PLL4.PLLP = 12;
	RCC_OscInitStructure.PLL4.PLLQ = 60;
	RCC_OscInitStructure.PLL4.PLLR = 6;
	RCC_OscInitStructure.PLL4.PLLRGE = RCC_PLL4IFRANGE_1;
	RCC_OscInitStructure.PLL4.PLLFRACV = 0;
	RCC_OscInitStructure.PLL4.PLLMODE = RCC_PLL_INTEGER;

	/* Enable access to RTC and backup registers */
	SET_BIT(PWR->CR1, PWR_CR1_DBP);
	/* Configure LSEDRIVE value */
	__HAL_RCC_LSEDRIVE_CONFIG(RCC_LSEDRIVE_MEDIUMHIGH);

	printk("step: before osc config\n\r");
	if (HAL_RCC_OscConfig(&RCC_OscInitStructure) != HAL_OK) {
		/* HAL RCC configuration error */
		Error_Handler();
		}
	printk("step: after osc config\n\r");

	/* Select PLLx as MPU, AXI and MCU clock sources */
	RCC_ClkInitStructure.ClockType = (RCC_CLOCKTYPE_MPU   | RCC_CLOCKTYPE_ACLK  |
																		RCC_CLOCKTYPE_HCLK  | RCC_CLOCKTYPE_PCLK4 |
																		RCC_CLOCKTYPE_PCLK5 | RCC_CLOCKTYPE_PCLK1 |
																		RCC_CLOCKTYPE_PCLK6 |
																		RCC_CLOCKTYPE_PCLK2 | RCC_CLOCKTYPE_PCLK3);

	RCC_ClkInitStructure.MPUInit.MPU_Clock = RCC_MPUSOURCE_PLL1;
	RCC_ClkInitStructure.MPUInit.MPU_Div = RCC_MPU_DIV2;
	RCC_ClkInitStructure.AXISSInit.AXI_Clock = RCC_AXISSOURCE_PLL2;
	RCC_ClkInitStructure.AXISSInit.AXI_Div = RCC_AXI_DIV1;
	RCC_ClkInitStructure.MLAHBInit.MLAHB_Clock = RCC_MLAHBSSOURCE_PLL3;
	RCC_ClkInitStructure.MLAHBInit.MLAHB_Div = RCC_MLAHB_DIV1;
	RCC_ClkInitStructure.APB1_Div = RCC_APB1_DIV2;
	RCC_ClkInitStructure.APB2_Div = RCC_APB2_DIV2;
	RCC_ClkInitStructure.APB3_Div = RCC_APB3_DIV2;
	RCC_ClkInitStructure.APB4_Div = RCC_APB4_DIV2;
	RCC_ClkInitStructure.APB5_Div = RCC_APB5_DIV4;
	RCC_ClkInitStructure.APB6_Div = RCC_APB6_DIV2;

	printk("step: before clock config\n\r");
	if (HAL_RCC_ClockConfig(&RCC_ClkInitStructure) != HAL_OK) {
		/* HAL RCC configuration error */
		Error_Handler();
		}
	printk("step: after clock config\n\r");

/*
	Note : The activation of the I/O Compensation Cell is recommended with communication  interfaces
	(GPIO, SPI, FMC, XSPI ...)  when  operating at  high frequencies(please refer to product datasheet)
	The I/O Compensation Cell activation  procedure requires :
	- The activation of the CSI clock
	- The activation of the SYSCFG clock
	- Enabling the I/O Compensation Cell : setting bit[0] of register SYSCFG_CCCSR

	To do this please uncomment the following code
	*/

	/*
	__HAL_RCC_CSI_ENABLE() ;

	__HAL_RCC_SYSCFG_CLK_ENABLE() ;

	HAL_EnableCompensationCell();
*/
	printk("step: sysclock end\n\r");
#endif
}

/**
	* @brief GPIO Initialization Function
	* @param None
	* @retval None
	*/
static void MX_GPIO_Init(void)
{

	/* GPIO Ports Clock Enable */

}

static void PrepareFsblStackHandoff(void)
{
	uint32_t *fsbl_sp_slot = (uint32_t *)0x5c00a110U;
	uint32_t handoff_sp = (uint32_t)&fsbl_handoff_stack[sizeof(fsbl_handoff_stack) - 8U];

	*fsbl_sp_slot = handoff_sp;
	printk("step: fsbl sp slot=0x%08x value=0x%08x (sysram stack)\n\r", (uint32_t)fsbl_sp_slot, handoff_sp);
}

/**
	* @brief  This function is executed in case of error occurrence.
	* @retval None
	*/
void Error_Handler(void)
{
	/* USER CODE BEGIN Error_Handler_Debug */
	/* User can add his own implementation to report the HAL error return state */

	/* USER CODE END Error_Handler_Debug */
}

#ifdef  USE_FULL_ASSERT
/**
	* @brief  Reports the name of the source file and the source line number
	*         where the assert_param error has occurred.
	* @param  file: pointer to the source file name
	* @param  line: assert_param error line source number
	* @retval None
	*/
void assert_failed(uint8_t *file, uint32_t line)
{ 
	/* USER CODE BEGIN 6 */
	/* User can add his own implementation to report the file name and line number,
		 tex: printf("Wrong parameters value: file %s on line %d\r\n", file, line) */
	/* USER CODE END 6 */
}
#endif /* USE_FULL_ASSERT */
```

## src/main.h
```c
/* USER CODE BEGIN Header */
/**
	******************************************************************************
	* @file    main.h
	* @brief   Header for main.c file.
	******************************************************************************
	*/
/* USER CODE END Header */

#ifndef __MAIN_H
#define __MAIN_H

#ifdef __cplusplus
extern "C" {
#endif

/* Includes ------------------------------------------------------------------*/
#include "stm32mp13xx_hal.h"

/* USER CODE BEGIN Includes */
#include "stm32mp13xx_disco.h"
#include "stm32mp13xx_disco_stpmic1.h"
/* USER CODE END Includes */

void Error_Handler(void);

#ifdef __cplusplus
}
#endif

#endif /* __MAIN_H */
```
